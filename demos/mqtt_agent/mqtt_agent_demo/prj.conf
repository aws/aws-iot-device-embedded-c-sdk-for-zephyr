## CMakeLists.txt
```
# SPDX-License-Identifier: Apache-2.0

cmake_minimum_required(VERSION 3.13.1)

find_package(Zephyr HINTS $ENV{ZEPHYR_BASE})
project(mqtt_mutual_auth)

FILE(GLOB app_sources src/*.c)
target_sources(app PRIVATE ${app_sources})

#for getting filepaths relative to the demo, but it's better to do it relative to the zephyr base
get_filename_component(CSDK_BASE "${CMAKE_SOURCE_DIR}/../../.." ABSOLUTE)

# Include MQTT library's source and header path variables.
include( ${CSDK_BASE}/libraries/standard/coreMQTT/mqttFilePaths.cmake )

include( ${CSDK_BASE}/libraries/standard/coreMQTT-Agent/mqttAgentFilePaths.cmake)

# Include backoffAlgorithm library file path configuration.
include( ${CSDK_BASE}/libraries/standard/backoffAlgorithm/backoffAlgorithmFilePaths.cmake )

# Include logging sources.
include( ${CSDK_BASE}/demos/logging-stack/logging.cmake )

#Include transport library implementations for Zephyr.
include( ${CSDK_BASE}/platform/zephyr/zephyrFilePaths.cmake )

#Include wifi connection function for ESP.
include( ${CSDK_BASE}/platform/espressif/espressifFilePaths.cmake)

# Include clock.
include( ${CSDK_BASE}/platform/zephyr/clock/clockFilePaths.cmake)

target_sources(app
    PRIVATE 
        ${MQTT_SOURCES}
        ${MQTT_AGENT_SOURCES}
        ${MQTT_SERIALIZER_SOURCES}
        ${BACKOFF_ALGORITHM_SOURCES}
        ${CLOCK_SOURCES}
        ${SOCKETS_SOURCES}
        ${MBEDTLS_SOURCES}
        ${WIFI_SOURCES}
        ${MQTT_AGENT_ZEPHYR_SOURCES}
)

target_include_directories(app
    PUBLIC
        ${MQTT_INCLUDE_PUBLIC_DIRS}
        ${MQTT_AGENT_INCLUDE_PUBLIC_DIRS}
        ${BACKOFF_ALGORITHM_INCLUDE_PUBLIC_DIRS}
        ${CMAKE_CURRENT_LIST_DIR}
        ${LOGGING_INCLUDE_DIRS}
        ${CLOCK_INCLUDE_DIRS}
        ${COMMON_TRANSPORT_INCLUDE_PUBLIC_DIRS}
        ${WIFI_INCLUDE_DIRS}
        ${MQTT_AGENT_ZEPHYR_INCLUDE_PUBLIC_DIRS}
)
```

## prj.conf
```kconfig
CONFIG_MINIMAL_LIBC_MALLOC_ARENA_SIZE=4096

CONFIG_MAIN_STACK_SIZE=4096

CONFIG_WIFI=y
CONFIG_WIFI_ESP32=y

CONFIG_NETWORKING=y
CONFIG_NET_TCP=y
CONFIG_NET_L2_ETHERNET=y

CONFIG_NET_CONTEXT_RCVTIMEO=y

CONFIG_NET_IPV6=n
CONFIG_NET_IPV4=y
CONFIG_NET_DHCPV4=y

CONFIG_DNS_RESOLVER=y

CONFIG_NET_LOG=y
CONFIG_NET_SHELL=n

CONFIG_NET_SOCKETS=y

CONFIG_MBEDTLS=y
CONFIG_MBEDTLS_BUILTIN=y
CONFIG_MBEDTLS_SSL_ALPN=y
CONFIG_MBEDTLS_PEM_CERTIFICATE_FORMAT=y
CONFIG_MBEDTLS_ENABLE_HEAP=y
CONFIG_MBEDTLS_SSL_MAX_CONTENT_LEN=16384

CONFIG_MBEDTLS_DEBUG=y

CONFIG_MBEDTLS_HEAP_SIZE=60000

CONFIG_MBEDTLS_ENTROPY_ENABLED=y
CONFIG_MBEDTLS_KEY_EXCHANGE_ECDHE_ECDSA_ENABLED=y
CONFIG_MBEDTLS_ECP_ALL_ENABLED=y
```

## src/demo_config.h
```c
/*
 * AWS IoT Device Embedded C SDK for ZephyrRTOS
 * Copyright (C) 2021 Amazon.com, Inc. or its affiliates.  All Rights Reserved.
 *
 * Permission is hereby granted, free of charge, to any person obtaining a copy of
 * this software and associated documentation files (the "Software"), to deal in
 * the Software without restriction, including without limitation the rights to
 * use, copy, modify, merge, publish, distribute, sublicense, and/or sell copies of
 * the Software, and to permit persons to whom the Software is furnished to do so,
 * subject to the following conditions:
 *
 * The above copyright notice and this permission notice shall be included in all
 * copies or substantial portions of the Software.
 *
 * THE SOFTWARE IS PROVIDED "AS IS", WITHOUT WARRANTY OF ANY KIND, EXPRESS OR
 * IMPLIED, INCLUDING BUT NOT LIMITED TO THE WARRANTIES OF MERCHANTABILITY, FITNESS
 * FOR A PARTICULAR PURPOSE AND NONINFRINGEMENT. IN NO EVENT SHALL THE AUTHORS OR
 * COPYRIGHT HOLDERS BE LIABLE FOR ANY CLAIM, DAMAGES OR OTHER LIABILITY, WHETHER
 * IN AN ACTION OF CONTRACT, TORT OR OTHERWISE, ARISING FROM, OUT OF OR IN
 * CONNECTION WITH THE SOFTWARE OR THE USE OR OTHER DEALINGS IN THE SOFTWARE.
 */

#ifndef DEMO_CONFIG_H_
#define DEMO_CONFIG_H_

#define MINIMAL_STACK_SIZE                    ( 1024 )

/* Constants that select which demos to build into the project:
 * Set the following to 1 to include the demo in the build, or 0 to exclude the
 * demo. */
#define NUM_SIMPLE_SUB_PUB_TASKS_TO_CREATE    1
#define SIMPLE_SUB_PUB_TASK_STACK_SIZE        ( MINIMAL_STACK_SIZE )

/**
 * @brief The MQTT client identifier used in this example.  Each client identifier
 * must be unique so edit as required to ensure no two clients connecting to the
 * same broker use the same client identifier.
 *
 *!!! Please note a #defined constant is used for convenience of demonstration
 *!!! only.  Production devices can use something unique to the device that can
 *!!! be read by software, such as a production serial number, instead of a
 *!!! hard coded constant.
 *
 */
#define CLIENT_IDENTIFIER                     "testclient"

/**
 * @brief Endpoint of the MQTT broker to connect to.
 *
 * This demo application can be run with any MQTT broker, although it is
 * recommended to use one that supports mutual authentication.
 *
 * For AWS IoT MQTT broker, this is the Thing's REST API Endpoint.
 *
 * @note Your AWS IoT Core endpoint can be found in the AWS IoT console under
 * Settings/Custom Endpoint, or using the describe-endpoint REST API (with
 * AWS CLI command line tool).
 *
 * #define MQTT_BROKER_ENDPOINT    "...insert here..."
 */

/**
 * @brief The port to use for the demo.
 *
 * In general, port 8883 is for secured MQTT connections, and port 1883 if not
 * using TLS.
 *
 * @note Port 443 requires use of the ALPN TLS extension with the ALPN protocol
 * name. Using ALPN with this demo would require additional changes, including
 * setting the `pAlpnProtos` member of the `NetworkCredentials_t` struct before
 * forming the TLS connection. When using port 8883, ALPN is not required.
 *
 * #define MQTT_BROKER_PORT    ( insert here. )
 */
#define MQTT_BROKER_PORT    ( 8883 )

/**
 * @brief Server's root CA certificate.
 *
 * For AWS IoT MQTT broker, this certificate is used to identify the AWS IoT
 * server and is publicly available. Refer to the AWS documentation available
 * in the link below.
 * https://docs.aws.amazon.com/iot/latest/developerguide/server-authentication.html#server-authentication-certs
 *
 * The preset default value is of AmazonRootCA1.pem, which can be found in the link below.
 * https://www.amazontrust.com/repository/AmazonRootCA1.pem
 *
 * @note This certificate should be PEM-encoded.
 *
 * Must include the PEM header and footer:
 * "-----BEGIN CERTIFICATE-----\n"\
 * "...base64 data...\n"\
 * "-----END CERTIFICATE-----"
 *
 * #define ROOT_CA_PEM    "...insert here..."
 */
#define ROOT_CA_PEM                                                      \
    "-----BEGIN CERTIFICATE-----\n"                                      \
    "MIIDQTCCAimgAwIBAgITBmyfz5m/jAo54vB4ikPmljZbyjANBgkqhkiG9w0BAQsF\n" \
    "ADA5MQswCQYDVQQGEwJVUzEPMA0GA1UEChMGQW1hem9uMRkwFwYDVQQDExBBbWF6\n" \
    "b24gUm9vdCBDQSAxMB4XDTE1MDUyNjAwMDAwMFoXDTM4MDExNzAwMDAwMFowOTEL\n" \
    "MAkGA1UEBhMCVVMxDzANBgNVBAoTBkFtYXpvbjEZMBcGA1UEAxMQQW1hem9uIFJv\n" \
    "b3QgQ0EgMTCCASIwDQYJKoZIhvcNAQEBBQADggEPADCCAQoCggEBALJ4gHHKeNXj\n" \
    "ca9HgFB0fW7Y14h29Jlo91ghYPl0hAEvrAIthtOgQ3pOsqTQNroBvo3bSMgHFzZM\n" \
    "9O6II8c+6zf1tRn4SWiw3te5djgdYZ6k/oI2peVKVuRF4fn9tBb6dNqcmzU5L/qw\n" \
    "IFAGbHrQgLKm+a/sRxmPUDgH3KKHOVj4utWp+UhnMJbulHheb4mjUcAwhmahRWa6\n" \
    "VOujw5H5SNz/0egwLX0tdHA114gk957EWW67c4cX8jJGKLhD+rcdqsq08p8kDi1L\n" \
    "93FcXmn/6pUCyziKrlA4b9v7LWIbxcceVOF34GfID5yHI9Y/QCB/IIDEgEw+OyQm\n" \
    "jgSubJrIqg0CAwEAAaNCMEAwDwYDVR0TAQH/BAUwAwEB/zAOBgNVHQ8BAf8EBAMC\n" \
    "AYYwHQYDVR0OBBYEFIQYzIU07LwMlJQuCFmcx7IQTgoIMA0GCSqGSIb3DQEBCwUA\n" \
    "A4IBAQCY8jdaQZChGsV2USggNiMOruYou6r4lK5IpDB/G/wkjUu0yKGX9rbxenDI\n" \
    "U5PMCCjjmCXPI6T53iHTfIUJrU6adTrCC2qJeHZERxhlbI1Bjjt/msv0tadQ1wUs\n" \
    "N+gDS63pYaACbvXy8MWy7Vu33PqUXHeeE6V/Uq2V8viTO96LXFvKWlJbYK8U90vv\n" \
    "o/ufQJVtMVT8QtPHRh8jrdkPSHCa2XV4cdFyQzR1bldZwgJcJmApzyMZFo6IQ6XU\n" \
    "5MsI+yMRQ+hDKXJioaldXgjUkK642M4UwtBV8ob2xJNDd2ZhwLnoQdeXeGADbkpy\n" \
    "rqXRfboQnoZsG4q5WTP468SQvvG5\n"                                     \
    "-----END CERTIFICATE-----"

/**
 * @brief An option to disable Server Name Indication.
 *
 * @note When using a local Mosquitto server setup, SNI needs to be disabled
 * for an MQTT broker that only has an IP address but no hostname. However,
 * SNI should be enabled whenever possible.
 */
#define DISABLE_SNI                ( 0 )

/**
 * @brief Configuration that indicates if the demo connection is made to the AWS IoT Core MQTT broker.
 *
 * If username/password based authentication is used, the demo will use appropriate TLS ALPN and
 * SNI configurations as required for the Custom Authentication feature of AWS IoT.
 * For more information, refer to the following documentation:
 * https://docs.aws.amazon.com/iot/latest/developerguide/custom-auth.html#custom-auth-mqtt
 *
 * #define USE_AWS_IOT_CORE_BROKER    ( 1 )
 */
#define USE_AWS_IOT_CORE_BROKER    ( 1 )

/**
 * @brief The username value for authenticating client to the MQTT broker when
 * username/password based client authentication is used.
 *
 * For AWS IoT MQTT broker, refer to the AWS IoT documentation below for
 * details regarding client authentication with a username and password.
 * https://docs.aws.amazon.com/iot/latest/developerguide/custom-authentication.html
 * An authorizer setup needs to be done, as mentioned in the above link, to use
 * username/password based client authentication.
 *
 * #define CLIENT_USERNAME    "...insert here..."
 */

/**
 * @brief The password value for authenticating client to the MQTT broker when
 * username/password based client authentication is used.
 *
 * For AWS IoT MQTT broker, refer to the AWS IoT documentation below for
 * details regarding client authentication with a username and password.
 * https://docs.aws.amazon.com/iot/latest/developerguide/custom-authentication.html
 * An authorizer setup needs to be done, as mentioned in the above link, to use
 * username/password based client authentication.
 *
 * #define CLIENT_PASSWORD    "...insert here..."
 */

/**
 * @brief The name of the operating system that the application is running on.
 * The current value is given as an example. Please update for your specific
 * operating system.
 */
#define OS_NAME                     "Zephyr"

/**
 * @brief The version of the operating system that the application is running
 * on. The current value is given as an example. Please update for your specific
 * operating system version.
 */
#define OS_VERSION                  "2.6.0"

/**
 * @brief The name of the hardware platform the application is running on. The
 * current value is given as an example. Please update for your specific
 * hardware platform.
 */
#define HARDWARE_PLATFORM_NAME      "ESP32"

/**
 * @brief The name of the MQTT library used and its version, following an "@"
 * symbol.
 */
#define MQTT_LIB                    "core-mqtt@" MQTT_LIBRARY_VERSION

/**
 * @brief Set the stack size of the main demo task.
 *
 */
#define DEMO_STACKSIZE              MINIMAL_STACK_SIZE

/**
 * @brief ALPN (Application-Layer Protocol Negotiation) protocol name for AWS IoT MQTT.
 *
 * This will be used if MQTT_BROKER_PORT is configured as 443 for the AWS IoT MQTT broker.
 * Please see more details about the ALPN protocol for AWS IoT MQTT endpoint
 * in the link below.
 * https://aws.amazon.com/blogs/iot/mqtt-with-tls-client-authentication-on-port-443-why-it-is-useful-and-how-it-works/
 */
#define AWS_IOT_MQTT_ALPN           "x-amzn-mqtt-ca"

/**
 * @brief This is the ALPN (Application-Layer Protocol Negotiation) string
 * required by AWS IoT for password-based authentication using TCP port 443.
 */
#define AWS_IOT_CUSTOM_AUTH_ALPN    "mqtt"

/**
 * Provide default values for undefined configuration settings.
 */
#ifndef OS_NAME
    #define OS_NAME    "Zephyr"
#endif

#ifndef OS_VERSION
    #define OS_VERSION    tskKERNEL_VERSION_NUMBER
#endif

#ifndef HARDWARE_PLATFORM_NAME
    #define HARDWARE_PLATFORM_NAME    "ESP32"
#endif

#ifndef MQTT_LIB
    #define MQTT_LIB    "core-mqtt@1.0.0"
#endif

/**
 * @brief The MQTT metrics string expected by AWS IoT.
 */
#define AWS_IOT_METRICS_STRING             \
    "?SDK=" OS_NAME "&Version=" OS_VERSION \
    "&Platform=" HARDWARE_PLATFORM_NAME "&MQTTLib=" MQTT_LIB

/**
 * @brief The length of the MQTT metrics string expected by AWS IoT.
 */
#define AWS_IOT_METRICS_STRING_LENGTH    ( ( uint16_t ) ( sizeof( AWS_IOT_METRICS_STRING ) - 1 ) )

#ifdef CLIENT_USERNAME

/**
 * @brief Append the username with the metrics string if #CLIENT_USERNAME is defined.
 *
 * This is to support both metrics reporting and username/password based client
 * authentication by AWS IoT.
 */
    #define CLIENT_USERNAME_WITH_METRICS    CLIENT_USERNAME AWS_IOT_METRICS_STRING
#endif

/**
 * @brief Length of client identifier.
 */
#define CLIENT_IDENTIFIER_LENGTH    ( ( uint16_t ) ( sizeof( CLIENT_IDENTIFIER ) - 1 ) )

/**
 * @brief Length of MQTT server host name.
 */
#define BROKER_ENDPOINT_LENGTH      ( ( uint16_t ) ( sizeof( MQTT_BROKER_ENDPOINT ) - 1 ) )

#define MQTT_MAX_DEMO_COUNT         ( 1 )

/**
 * @brief The name of the Wi-Fi network to join.
 *
 * #define WIFI_NETWORK_SSID        "...insert here..."
 */

/**
 * @brief Password needed to join Wi-Fi network. If you are using WPA, set this
 * to your network password. If there is no password, use the empty string "".
 *
 * #define WIFI_NETWORK_PASSWORD    "...insert here...."
 */

#endif /* DEMO_CONFIG_H_ */
```

## src/simple_pub_sub_demo.c
```c
/*
 * AWS IoT Device Embedded C SDK for ZephyrRTOS
 * Copyright (C) 2021 Amazon.com, Inc. or its affiliates.  All Rights Reserved.
 *
 * Permission is hereby granted, free of charge, to any person obtaining a copy of
 * this software and associated documentation files (the "Software"), to deal in
 * the Software without restriction, including without limitation the rights to
 * use, copy, modify, merge, publish, distribute, sublicense, and/or sell copies of
 * the Software, and to permit persons to whom the Software is furnished to do so,
 * subject to the following conditions:
 *
 * The above copyright notice and this permission notice shall be included in all
 * copies or substantial portions of the Software.
 *
 * THE SOFTWARE IS PROVIDED "AS IS", WITHOUT WARRANTY OF ANY KIND, EXPRESS OR
 * IMPLIED, INCLUDING BUT NOT LIMITED TO THE WARRANTIES OF MERCHANTABILITY, FITNESS
 * FOR A PARTICULAR PURPOSE AND NONINFRINGEMENT. IN NO EVENT SHALL THE AUTHORS OR
 * COPYRIGHT HOLDERS BE LIABLE FOR ANY CLAIM, DAMAGES OR OTHER LIABILITY, WHETHER
 * IN AN ACTION OF CONTRACT, TORT OR OTHERWISE, ARISING FROM, OUT OF OR IN
 * CONNECTION WITH THE SOFTWARE OR THE USE OR OTHER DEALINGS IN THE SOFTWARE.
 */

/*
 * This file demonstrates numerous tasks all of which use the MQTT agent API
 * to send unique MQTT payloads to unique topics over the same MQTT connection
 * to the same MQTT agent.  Some tasks use QoS0 and others QoS1.
 *
 * Each created task is a unique instance of the task implemented by
 * simpleSubscribePublishTask().  simpleSubscribePublishTask()
 * subscribes to a topic then periodically publishes a message to the same
 * topic to which it has subscribed.  The command context sent to
 * MQTTAgent_Publish() contains a unique number that is sent back to the task
 * as a task notification from the callback function that executes when the
 * PUBLISH operation is acknowledged (or just sent in the case of QoS 0).  The
 * task checks the number it receives from the callback equals the number it
 * previously set in the command context before printing out either a success
 * or failure message.
 */

/* Kernel include. */
#include <zephyr.h>

/* Standard includes. */
#include <string.h>
#include <stdio.h>
#include <assert.h>

/* Demo Specific configs. */
#include "demo_config.h"

/* MQTT library includes. */
#include "core_mqtt.h"

/* MQTT agent include. */
#include "core_mqtt_agent.h"

/* Subscription manager header include. */
#include "subscription_manager.h"

/**
 * @brief This demo uses task notifications to signal tasks from MQTT callback
 * functions.  MS_TO_WAIT_FOR_NOTIFICATION defines the time, in ticks,
 * to wait for such a callback.
 */
#define MS_TO_WAIT_FOR_NOTIFICATION            ( 10000 )

/**
 * @brief Size of statically allocated buffers for holding topic names and
 * payloads.
 */
#define STRING_BUFFER_LENGTH                   ( 100 )

/**
 * @brief Delay for each task between publishes.
 */
#define DELAY_BETWEEN_PUBLISH_OPERATIONS_MS    ( 1000U )

/**
 * @brief Number of publishes done by each task in this demo.
 */
#define PUBLISH_COUNT                          ( 10UL )

/**
 * @brief The maximum amount of time in milliseconds to wait for the commands
 * to be posted to the MQTT agent should the MQTT agent's command queue be full.
 * Tasks wait in the Blocked state, so don't use any CPU time.
 */
#define MAX_COMMAND_SEND_BLOCK_TIME_MS         ( 500 )

/**
 * @brief The modulus with which to reduce a task number to obtain the task's
 * publish QoS value. Must be either to 1, 2, or 3, resulting in maximum QoS
 * values of 0, 1, and 2, respectively.
 */
#define QOS_MODULUS                            ( 2UL )

/*-----------------------------------------------------------*/

/**
 * @brief Defines the structure to use as the command callback context in this
 * demo.
 */
struct MQTTAgentCommandContext
{
    MQTTStatus_t returnStatus;
    uint32_t taskNum;
    uint32_t notificationValue;
    void * pArgs;
};

/**
 * @brief Parameters for this task.
 */
struct SimplePubSubDemoParams
{
    uint32_t taskNumber;
    bool success;
};

/*-----------------------------------------------------------*/

/**
 * @brief Passed into MQTTAgent_Subscribe() as the callback to execute when the
 * broker ACKs the SUBSCRIBE message.  Its implementation sends a notification
 * to the task that called MQTTAgent_Subscribe() to let the task know the
 * SUBSCRIBE operation completed.  It also sets the returnStatus of the
 * structure passed in as the command's context to the value of the
 * returnStatus parameter - which enables the task to check the status of the
 * operation.
 *
 * See https://freertos.org/mqtt/mqtt-agent-demo.html#example_mqtt_api_call
 *
 * @param[in] pCommandContext Context of the initial command.
 * @param[in] pReturnInfo The result of the command.
 */
static void subscribeCommandCallback( MQTTAgentCommandContext_t * pCommandContext,
                                      MQTTAgentReturnInfo_t * pReturnInfo );

/**
 * @brief Passed into MQTTAgent_Publish() as the callback to execute when the
 * broker ACKs the PUBLISH message.  Its implementation sends a notification
 * to the task that called MQTTAgent_Publish() to let the task know the
 * PUBLISH operation completed.  It also sets the returnStatus of the
 * structure passed in as the command's context to the value of the
 * returnStatus parameter - which enables the task to check the status of the
 * operation.
 *
 * See https://freertos.org/mqtt/mqtt-agent-demo.html#example_mqtt_api_call
 *
 * @param[in] pCommandContext Context of the initial command.
 * @param[in] pReturnInfo The result of the command.
 */
static void publishCommandCallback( MQTTAgentCommandContext_t * pCommandContext,
                                    MQTTAgentReturnInfo_t * pReturnInfo );

/**
 * @brief Called by the task to wait for a notification from a callback function
 * after the task first executes either MQTTAgent_Publish()* or
 * MQTTAgent_Subscribe().
 *
 * See https://freertos.org/mqtt/mqtt-agent-demo.html#example_mqtt_api_call
 *
 * @param[in] pCommandContext Context of the initial command.
 *
 * @return true if the task received a notification, otherwise false.
 */
static bool waitForCommandAcknowledgment( uint32_t taskNumber );

/**
 * @brief Passed into MQTTAgent_Subscribe() as the callback to execute when
 * there is an incoming publish on the topic being subscribed to.  Its
 * implementation just logs information about the incoming publish including
 * the publish messages source topic and payload.
 *
 * See https://freertos.org/mqtt/mqtt-agent-demo.html#example_mqtt_api_call
 *
 * @param[in] pIncomingPublishCallbackContext Context of the initial command.
 * @param[in] pPublishInfo Deserialized publish.
 */
static void incomingPublishCallback( void * pIncomingPublishCallbackContext,
                                     MQTTPublishInfo_t * pPublishInfo );

/**
 * @brief Subscribe to the topic the demo task will also publish to - that
 * results in all outgoing publishes being published back to the task
 * (effectively echoed back).
 *
 * @param[in] QoS The quality of service (QoS) to use.  Can be zero or one
 * for all MQTT brokers.  Can also be QoS2 if supported by the broker.  AWS IoT
 * does not support QoS2.
 * @param[in] pTopicFilter Topic filter to subscribe to.
 * @param[in] taskNumber Identifier for the task performing the subscribe.
 */
static bool subscribeToTopic( MQTTQoS_t QoS,
                              char * pTopicFilter,
                              uint32_t taskNumber );

/**
 * @brief The function that implements the task demonstrated by this file.
 *
 * @param[in] pParameters A pointer to a SimplePubSubDemoParams struct with
 * parameters for this function.
 * @param[in] b Unused parameter to fit Zephyr thread creation. Can just be NULL.
 * @param[in] c Unused parameter to fit Zephyr thread creation. Can just be NULL.
 */
static void simpleSubscribePublishTask( void * pParameters,
                                        void * b,
                                        void * c );

/*-----------------------------------------------------------*/

/**
 * @brief The MQTT agent manages the MQTT contexts.  This set the handle to the
 * context used by this demo.
 */
extern MQTTAgentContext_t globalMqttAgentContext;

/*-----------------------------------------------------------*/

/**
 * @brief Array of thread handles for representing all the threads created for
 * Publish-Subscribe operations in the demo.
 */
struct k_thread simpleSubPubThreads[ NUM_SIMPLE_SUB_PUB_TASKS_TO_CREATE ];

/**
 * @brief Semaphore to block at certain points of each thread's running to wait for publishes
 * and subscribes to complete.
 */
static struct k_sem subPubSems[ NUM_SIMPLE_SUB_PUB_TASKS_TO_CREATE ];

/**
 * @brief The buffer to hold the topic filter. The topic is generated at runtime
 * by adding the task names.
 *
 * @note The topic strings must persist until unsubscribed.
 */
static char topicBuf[ NUM_SIMPLE_SUB_PUB_TASKS_TO_CREATE ][ STRING_BUFFER_LENGTH ];

/*-----------------------------------------------------------*/

/**
 * @brief Define pubStackArea as the stack array area for all the simple sub pub threads.
 */
K_THREAD_STACK_ARRAY_DEFINE( pubSubStackArea, NUM_SIMPLE_SUB_PUB_TASKS_TO_CREATE, SIMPLE_SUB_PUB_TASK_STACK_SIZE );

/*-----------------------------------------------------------*/

void StartSimpleSubscribePublishTask( uint32_t numberToCreate,
                                      size_t stackSize,
                                      int priority,
                                      struct SimplePubSubDemoParams * pParams )
{
    uint32_t taskNumber;

    /* Each instance of simpleSubscribePublishTask() generates a unique name
     * and topic filter for itself from the number passed in as the task
     * parameter. */
    /* Create a few instances of simpleSubscribePublishTask(). */
    for( taskNumber = 0; taskNumber < numberToCreate; taskNumber++ )
    {
        k_sem_init( &( subPubSems[ taskNumber ] ), 0, 1 );

        pParams[ taskNumber ].taskNumber = taskNumber;
        pParams[ taskNumber ].success = false;
        k_thread_create( &( simpleSubPubThreads[ taskNumber ] ),
                         pubSubStackArea[ taskNumber ],
                         stackSize,
                         simpleSubscribePublishTask,
                         ( void * ) &pParams[ taskNumber ],
                         NULL,
                         NULL,
                         priority,
                         0,
                         K_NO_WAIT );
    }
}

/*-----------------------------------------------------------*/

static void publishCommandCallback( MQTTAgentCommandContext_t * pCommandContext,
                                    MQTTAgentReturnInfo_t * pReturnInfo )
{
    /* Store the result in the application defined context so the task that
     * initiated the publish can check the operation's status. */
    pCommandContext->returnStatus = pReturnInfo->returnCode;

    k_sem_give( &( subPubSems[ pCommandContext->taskNum ] ) );
}

/*-----------------------------------------------------------*/

static void subscribeCommandCallback( MQTTAgentCommandContext_t * pCommandContext,
                                      MQTTAgentReturnInfo_t * pReturnInfo )
{
    bool subscriptionAdded = false;
    MQTTAgentSubscribeArgs_t * pxSubscribeArgs = ( MQTTAgentSubscribeArgs_t * ) pCommandContext->pArgs;

    /* Store the result in the application defined context so the task that
     * initiated the subscribe can check the operation's status. */
    pCommandContext->returnStatus = pReturnInfo->returnCode;

    /* Check if the subscribe operation is a success. Only one topic is
     * subscribed by this demo. */
    if( pReturnInfo->returnCode == MQTTSuccess )
    {
        /* Add subscription so that incoming publishes are routed to the application
         * callback. */
        subscriptionAdded = addSubscription( ( SubscriptionElement_t * ) globalMqttAgentContext.pIncomingCallbackContext,
                                             pxSubscribeArgs->pSubscribeInfo->pTopicFilter,
                                             pxSubscribeArgs->pSubscribeInfo->topicFilterLength,
                                             incomingPublishCallback,
                                             NULL );

        if( !subscriptionAdded )
        {
            LogError( ( "Failed to register an incoming publish callback for topic %.*s.",
                        pxSubscribeArgs->pSubscribeInfo->topicFilterLength,
                        pxSubscribeArgs->pSubscribeInfo->pTopicFilter ) );
        }
    }

    k_sem_give( &( subPubSems[ pCommandContext->taskNum ] ) );
}

/*-----------------------------------------------------------*/

static bool waitForCommandAcknowledgment( uint32_t taskNumber )
{
    bool returnStatus;

    returnStatus = ( 0 == k_sem_take( &( subPubSems[ taskNumber ] ), K_MSEC( MS_TO_WAIT_FOR_NOTIFICATION ) ) );

    return returnStatus;
}

/*-----------------------------------------------------------*/

static void incomingPublishCallback( void * pIncomingPublishCallbackContext,
                                     MQTTPublishInfo_t * pPublishInfo )
{
    static char terminatedString[ STRING_BUFFER_LENGTH ];

    ( void ) pIncomingPublishCallbackContext;

    /* Create a message that contains the incoming MQTT payload to the logger,
     * terminating the string first. */
    if( pPublishInfo->payloadLength < STRING_BUFFER_LENGTH )
    {
        memcpy( ( void * ) terminatedString, pPublishInfo->pPayload, pPublishInfo->payloadLength );
        terminatedString[ pPublishInfo->payloadLength ] = 0x00;
    }
    else
    {
        memcpy( ( void * ) terminatedString, pPublishInfo->pPayload, STRING_BUFFER_LENGTH );
        terminatedString[ STRING_BUFFER_LENGTH - 1 ] = 0x00;
    }

    LogInfo( ( "Received incoming publish message %s", terminatedString ) );
}

/*-----------------------------------------------------------*/

static bool subscribeToTopic( MQTTQoS_t QoS,
                              char * pTopicFilter,
                              uint32_t taskNumber )
{
    MQTTStatus_t commandAdded;
    bool commandAcknowledged = false;
    uint32_t subscribeMessageID;
    MQTTAgentSubscribeArgs_t subscribeArgs;
    MQTTSubscribeInfo_t subscribeInfo;
    static int32_t nextSubscribeMessageID = 0;
    MQTTAgentCommandContext_t applicationDefinedContext = { 0 };
    MQTTAgentCommandInfo_t commandParams = { 0 };

    nextSubscribeMessageID++;
    subscribeMessageID = nextSubscribeMessageID;

    /* Complete the subscribe information.  The topic string must persist for
     * duration of subscription! */
    subscribeInfo.pTopicFilter = pTopicFilter;
    subscribeInfo.topicFilterLength = ( uint16_t ) strlen( pTopicFilter );
    subscribeInfo.qos = QoS;
    subscribeArgs.pSubscribeInfo = &subscribeInfo;
    subscribeArgs.numSubscriptions = 1;

    /* Complete an application defined context associated with this subscribe message.
     * This gets updated in the callback function so the variable must persist until
     * the callback executes. */
    applicationDefinedContext.notificationValue = subscribeMessageID;
    applicationDefinedContext.taskNum = taskNumber;
    applicationDefinedContext.pArgs = ( void * ) &subscribeArgs;

    commandParams.blockTimeMs = MAX_COMMAND_SEND_BLOCK_TIME_MS;
    commandParams.cmdCompleteCallback = subscribeCommandCallback;
    commandParams.pCmdCompleteCallbackContext = ( void * ) &applicationDefinedContext;

    /* The queue will not become full if the priority of the MQTT agent task is
     * higher than the priority of the task calling this function. */
    LogInfo( ( "Sending subscribe request to agent for topic filter: %s with id %d",
               pTopicFilter,
               ( int ) subscribeMessageID ) );

    commandAdded = MQTTAgent_Subscribe( &globalMqttAgentContext,
                                        &subscribeArgs,
                                        &commandParams );

    if( commandAdded == MQTTSuccess )
    {
        /* Wait for acks to the subscribe message - this is optional but done here
         * so the code below can check the notification sent by the callback matches
         * the nextSubscribeMessageID value set in the context above. */
        commandAcknowledged = waitForCommandAcknowledgment( taskNumber );
    }
    else
    {
        LogError( ( "Failed to enqueue subscribe command." ) );
    }

    /* Check all ways the status was passed back just for demonstration
     * purposes. */
    if( ( commandAcknowledged != true ) ||
        ( applicationDefinedContext.returnStatus != MQTTSuccess ) )
    {
        LogWarn( ( "Error or timed out waiting for ack to subscribe message topic %s",
                   pTopicFilter ) );
    }
    else
    {
        LogInfo( ( "Received subscribe ack for topic %s containing ID %d",
                   pTopicFilter,
                   ( int ) applicationDefinedContext.notificationValue ) );
    }

    return commandAcknowledged;
}

/*-----------------------------------------------------------*/

static void simpleSubscribePublishTask( void * pParameters,
                                        void * b,
                                        void * c )
{
    MQTTPublishInfo_t publishInfo = { 0 };
    char payloadBuf[ STRING_BUFFER_LENGTH ];
    char taskName[ STRING_BUFFER_LENGTH ];
    MQTTAgentCommandContext_t commandContext;
    uint32_t valueToNotify = 0UL;
    MQTTStatus_t commandAdded;
    struct SimplePubSubDemoParams * pParams = ( struct SimplePubSubDemoParams * ) pParameters;
    uint32_t taskNumber = pParams->taskNumber;
    MQTTQoS_t QoS;
    MQTTAgentCommandInfo_t commandParams = { 0 };
    char * pTopicBuffer = topicBuf[ taskNumber ];
    uint32_t numSuccesses = 0U;

    /* Have different tasks use different QoS.  0 and 1.  2 can also be used
     * if supported by the broker. */
    QoS = ( MQTTQoS_t ) ( taskNumber % QOS_MODULUS );

    /* Create a unique name for this task from the task number that is passed into
     * the task using the task's parameter. */
    snprintf( taskName, STRING_BUFFER_LENGTH, "Publisher%d", ( int ) taskNumber );

    /* Create a topic name for this task to publish to. */
    snprintf( pTopicBuffer, STRING_BUFFER_LENGTH, "/filter/%s", taskName );

    /* Subscribe to the same topic to which this task will publish.  That will
     * result in each published message being published from the server back to
     * the target. */
    subscribeToTopic( QoS, pTopicBuffer, taskNumber );

    /* Configure the publish operation. */
    memset( ( void * ) &publishInfo, 0x00, sizeof( publishInfo ) );
    publishInfo.qos = QoS;
    publishInfo.pTopicName = pTopicBuffer;
    publishInfo.topicNameLength = ( uint16_t ) strlen( pTopicBuffer );
    publishInfo.pPayload = payloadBuf;

    /* Store the handler to this task in the command context so the callback
     * that executes when the command is acknowledged can send a notification
     * back to this task. */
    memset( ( void * ) &commandContext, 0x00, sizeof( commandContext ) );
    commandContext.taskNum = taskNumber;

    commandParams.blockTimeMs = MAX_COMMAND_SEND_BLOCK_TIME_MS;
    commandParams.cmdCompleteCallback = publishCommandCallback;
    commandParams.pCmdCompleteCallbackContext = &commandContext;

    /* For a finite number of publishes... */
    for( valueToNotify = 0UL; valueToNotify < PUBLISH_COUNT; valueToNotify++ )
    {
        /* Create a payload to send with the publish message.  This contains
         * the task name and an incrementing number. */
        snprintf( payloadBuf,
                  STRING_BUFFER_LENGTH,
                  "%s publishing message %d",
                  taskName,
                  ( int ) valueToNotify );

        publishInfo.payloadLength = ( uint16_t ) strlen( payloadBuf );

        /* Also store the incrementing number in the command context so it can
         * be accessed by the callback that executes when the publish operation
         * is acknowledged. */
        commandContext.notificationValue = valueToNotify;

        LogInfo( ( "Sending publish request to agent with message \"%s\" on topic \"%s\"",
                   payloadBuf,
                   pTopicBuffer ) );

        commandAdded = MQTTAgent_Publish( &globalMqttAgentContext,
                                          &publishInfo,
                                          &commandParams );

        if( commandAdded == MQTTSuccess )
        {
            /* For QoS 1 and 2, wait for the publish acknowledgment.  For QoS0,
             * wait for the publish to be sent. */
            LogInfo( ( "Task %s waiting for publish %d to complete.",
                       taskName,
                       valueToNotify ) );
            waitForCommandAcknowledgment( taskNumber );
        }
        else
        {
            LogError( ( "Failed to enqueue publish command. Error code=%s", MQTT_Status_strerror( commandAdded ) ) );
        }

        /* The value received by the callback that executed when the publish was
         * completed came from the context passed into MQTTAgent_Publish() above,
         * so should match the value set in the context above. */
        numSuccesses++;
        /* Log statement to indicate successful reception of publish. */
        LogInfo( ( "Publish %d completed successfully.\r\n", valueToNotify ) );

        LogInfo( ( "Short delay before next publish... \r\n\r\n" ) );

        k_sleep( K_MSEC( DELAY_BETWEEN_PUBLISH_OPERATIONS_MS ) );
    }

    /* Mark this task as successful if every publish was successfully completed. */
    if( numSuccesses == PUBLISH_COUNT )
    {
        pParams->success = true;
        LogInfo( ( "Task %s successful.", taskName ) );
    }

    /* Task will terminate itself after returning from entry (this) function. */
}
```
